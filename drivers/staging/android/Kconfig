## drivers/staging/android/Kconfig
```kconfig
# SPDX-License-Identifier: GPL-2.0
menu "Android"

config ANDROID_STAGING
	bool

config ASHMEM
	bool "Enable the Anonymous Shared Memory Subsystem"
	depends on SHMEM
	select ANDROID_STAGING
	help
	  The ashmem subsystem is a new shared memory allocator, similar to
	  POSIX SHM but with different behavior and sporting a simpler
	  file-based API.

	  It is, in theory, a good memory allocator for low-memory devices,
	  because it can discard shared memory units when under memory pressure.

config ASHMEM_RUST
	bool "Use the Rust implementation of Ashmem"
	depends on ASHMEM && RUST

config ASHMEM_C
	def_bool ASHMEM && !ASHMEM_RUST

config ANDROID_FWDATA
	tristate "Parser for Android-specific firmware data"
	depends on ACPI
	default n
	help
	  This driver parses Android-specific data (e.g. fstab configuration)
	  stored in firmware (e.g. ACPI tables), and present it to user space
	  via sysfs. Android Oreo (8.0) and later requires some essential boot-
	  time configuration to be available in a directory structure organized
	  in Device Tree style, e.g. /proc/device-tree/firmware/android/ on
	  platforms that enable DT. Platforms that use ACPI instead of DT, such
	  as Goldfish (Ranchu) x86/x86_64, should enable this driver to ensure
	  the required information can be found in sysfs with the expected
	  layout.

endmenu
```
